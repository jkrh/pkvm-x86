## scripts/q35_defconfig
```kconfig
CONFIG_CBFS_SIZE=0x01000000
CONFIG_BOARD_EMULATION_QEMU_X86_Q35=y
CONFIG_LINUX_COMMAND_LINE=""
CONFIG_COREBOOT_ROMSIZE_KB_16384=y
# CONFIG_PCIEXP_HOTPLUG is not set
# CONFIG_PCI_ALLOW_BUS_MASTER is not set
# CONFIG_DRIVERS_MTK_WIFI is not set
CONFIG_PAYLOAD_LINUX=y
CONFIG_GDB_STUB=y
CONFIG_PAYLOAD_FILE=bzImage
```

## scripts/q35_guest_defconfig
```kconfig
CONFIG_CBFS_SIZE=0x01000000
CONFIG_BOARD_EMULATION_QEMU_X86_Q35=y
CONFIG_LINUX_COMMAND_LINE="root=/dev/vda1 swiotlb=force mem=3G nokaslr ignore_loglevel console=ttyS0 earlyprintk=serial rw"
CONFIG_COREBOOT_ROMSIZE_KB_16384=y
# CONFIG_PCIEXP_HOTPLUG is not set
# CONFIG_PCI_ALLOW_BUS_MASTER is not set
# CONFIG_DRIVERS_MTK_WIFI is not set
CONFIG_PAYLOAD_LINUX=y
# CONFIG_GDB_STUB is not set
CONFIG_PAYLOAD_FILE=bzImage
CONFIG_PROTECTED_GUEST=y
```
